## meta-baize/conf/layer.conf
```bitbake
# We have a conf and classes directory, add to BBPATH
BBPATH .= ":${LAYERDIR}"

# We have recipes-* directories, add to BBFILES
BBFILES += "${LAYERDIR}/recipes-*/*/*.bb \
            ${LAYERDIR}/recipes-*/*/*.bbappend"

BBFILE_COLLECTIONS += "meta-baize"
BBFILE_PATTERN_meta-baize = "^${LAYERDIR}/"
BBFILE_PRIORITY_meta-baize = "6"

LAYERDEPENDS_meta-baize = "core"
LAYERSERIES_COMPAT_meta-baize = "kirkstone langdale"
```

## meta-tee/conf/layer.conf
```bitbake
# We have a conf and classes directory, add to BBPATH
BBPATH .= ":${LAYERDIR}"

# We have recipes-* directories, add to BBFILES
BBFILES += "${LAYERDIR}/recipes-*/*/*.bb \
            ${LAYERDIR}/recipes-*/*/*.bbappend"

BBFILE_COLLECTIONS += "meta-tee"
BBFILE_PATTERN_meta-tee = "^${LAYERDIR}/"
BBFILE_PRIORITY_meta-tee = "6"

LAYERDEPENDS_meta-tee = "core"
LAYERSERIES_COMPAT_meta-tee = "kirkstone langdale"
```

## meta/conf/machine/fake-arm64.conf
```bitbake
#@TYPE: Machine
#@NAME: fake ARMv8 machine
#@DESCRIPTION: Machine configuration for running an ARMv8 system on

require conf/machine/include/arm/armv8a/tune-cortexa57.inc
#require conf/machine/include/qemu.inc

KERNEL_IMAGETYPE = "Image"

SERIAL_CONSOLES ?= "115200;ttyAMA0 115200;hvc0"
SERIAL_CONSOLES_CHECK = "${SERIAL_CONSOLES}"
```
